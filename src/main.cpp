#include "main.h"

//Create ILI9341 display object
Adafruit_ILI9341 tft = Adafruit_ILI9341(TFT_CS, TFT_DC);

//Create XPT2046 object
XPT2046_Touchscreen ts(TOUCH_CS, TOUCH_IRQ);

//Set to true if you want the diagnostic text footer
const bool debug = true;

//This holds the accumulator for the average
float averageAccumulatorBlack = 0.0;
int averageCountBlack = 1;
float averageHolderBlack = 0.0;

//Variables for web server
char server_ssid[30];

//Holds string representation of selected sensors
char sensorSelections[10] = "1000";

//Create web server
const byte DNS_PORT = 53;
IPAddress apIP(192, 168, 4, 1);
DNSServer dnsServer;
ESP8266WebServer server(80);

//Initialize web server off
bool webServerOn = false;

//A pointer to the currently selected sensor
FliteSensor *fliteSensorSelected;

//Declare fliteSensors
char blackString[10] = "BLACK";
FliteSensor fliteSensorBlack = FliteSensor(blackString, 201, 211, 221, 231, 241);
char blueString[10] = "BLUE";
FliteSensor fliteSensorBlue = FliteSensor(blueString, 251, 261, 271, 281, 291);
char redString[10] = "RED";
FliteSensor fliteSensorRed = FliteSensor(redString, 301, 311, 321, 331, 341);
char greenString[10] = "GREEN";
FliteSensor fliteSensorGreen = FliteSensor(greenString, 351, 361, 371, 381, 391);

//Used to hold level during calibration
float levelHolder = 0.0;

//Counters used during loop logic
int msCounter = 0;
int secondsCounter = 0;

//Maintenance mode flag
bool maintMode = false;

//Define icons
//WIFI
const unsigned char WiFiIconBitmap[] PROGMEM = {
    // 'wireless-32, 35x35px
    0x00, 0x00, 0x00, 0x00, 0x00, 0x00, 0x00, 0x00, 0x00, 0x00, 0x00, 0x00, 0x00, 0x00, 0x00, 0x00,
    0x00, 0x00, 0x00, 0x00, 0x00, 0x07, 0xfc, 0x00, 0x00, 0x00, 0x3f, 0xff, 0x80, 0x00, 0x01, 0xff,
    0xff, 0xf0, 0x00, 0x07, 0xff, 0xff, 0xfc, 0x00, 0x0f, 0xff, 0xff, 0xfe, 0x00, 0x3f, 0xe0, 0x00,
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    0x00, 0x00, 0x00, 0x00, 0x00, 0x00, 0x00, 0x00, 0x00, 0x00, 0x00, 0x00, 0x00, 0x00, 0x00};

const GFXbitmapGlyph WiFiIconGlyphs[] PROGMEM = {
    {0, 35, 35, 0, '0'} // 'wireless-32'
};

const GFXbitmapFont WiFiIconFont PROGMEM = {
    (uint8_t *)WiFiIconBitmap,
    (GFXbitmapGlyph *)WiFiIconGlyphs,
    1};

//FLITE LOGO
const unsigned char FliteBitmap[] PROGMEM = {
    // 'b9ac7bf7-a78c-4166-900a-bafe549432e4_200x200, 200x200px
    0x00, 0x00, 0x00, 0x00, 0x00, 0x00, 0x00, 0x00, 0x00, 0x00, 0x00, 0x00, 0x00, 0x00, 0x00, 0x00,
    0x00, 0x00, 0x00, 0x00, 0x00, 0x00, 0x00, 0x00, 0x00, 0x00, 0x00, 0x00, 0x00, 0x00, 0x00, 0x00,
    0x00, 0x00, 0x00, 0x00, 0x00, 0x00, 0x00, 0x00, 0x00, 0x00, 0x00, 0x00, 0x00, 0x00, 0x00, 0x00,
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    0x00, 0x00, 0x00, 0x00, 0x00, 0x00, 0x00, 0x00};

const GFXbitmapGlyph FliteGlyphs[] PROGMEM = {
    {0, 200, 200, 0, '0'} // 'b9ac7bf7-a78c-4166-900a-bafe549432e4_200x200'
};

const GFXbitmapFont FliteFont PROGMEM = {
    (uint8_t *)FliteBitmap,
    (GFXbitmapGlyph *)FliteGlyphs,
    1};

//WRENCH
const unsigned char WrenchIconBitmap[] PROGMEM = {
    // 'wrench-32, 35x35px
    0x00, 0x00, 0x03, 0xe0, 0x00, 0x00, 0x00, 0x0f, 0xe0, 0x00, 0x00, 0x00, 0x1f, 0xc0, 0x00, 0x00,
    0x00, 0x3f, 0x80, 0x00, 0x00, 0x00, 0x7f, 0x00, 0x00, 0x00, 0x00, 0xff, 0x00, 0x00, 0x00, 0x00,
    0xfe, 0x00, 0x00, 0x00, 0x00, 0xff, 0x00, 0x00, 0x00, 0x01, 0xff, 0x00, 0x60, 0x00, 0x01, 0xff,
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    0xff, 0x00, 0x00, 0x00, 0x00, 0xfe, 0x00, 0x00, 0x00, 0x00, 0x38, 0x00, 0x00, 0x00, 0x00};

const GFXbitmapGlyph WrenchIconGlyphs[] PROGMEM = {
    {0, 35, 35, 0, '0'} // 'wrench-32'
};

const GFXbitmapFont WrenchIconFont PROGMEM = {
    (uint8_t *)WrenchIconBitmap,
    (GFXbitmapGlyph *)WrenchIconGlyphs,
    1};

//DOWN ARROW
const unsigned char DownArrowBitmap[] PROGMEM = {
    // 'arrow-214-32, 40x40px
    0x00, 0x00, 0x00, 0x00, 0x00, 0x00, 0x00, 0x00, 0x00, 0x00, 0x00, 0x00, 0x00, 0x00, 0x00, 0x00,
    0x00, 0x00, 0x00, 0x00, 0x78, 0x00, 0x00, 0x00, 0x1e, 0x7f, 0x00, 0x00, 0x00, 0xfe, 0x3f, 0xe0,
    0x00, 0x07, 0xfc, 0x1f, 0xfc, 0x00, 0x3f, 0xf8, 0x1f, 0xff, 0x00, 0xff, 0xf8, 0x0f, 0xff, 0xff,
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    0x00, 0x00, 0x00, 0x00, 0x00, 0x00, 0x00, 0x00};

const GFXbitmapGlyph DownArrowGlyphs[] PROGMEM = {
    {0, 40, 40, 0, '0'} // 'arrow-214-32'
};

const GFXbitmapFont DownArrowFont PROGMEM = {
    (uint8_t *)DownArrowBitmap,
    (GFXbitmapGlyph *)DownArrowGlyphs,
    1};

//UP ARROW
const unsigned char UpArrowBitmap[] PROGMEM = {
    // 'arrow-152-32, 40x40px
    0x00, 0x00, 0x00, 0x00, 0x00, 0x00, 0x00, 0x00, 0x00, 0x00, 0x00, 0x00, 0x00, 0x00, 0x00, 0x00,
    0x00, 0x00, 0x00, 0x00, 0x00, 0x00, 0x18, 0x00, 0x00, 0x00, 0x00, 0x1c, 0x00, 0x00, 0x00, 0x00,
    0x3c, 0x00, 0x00, 0x00, 0x00, 0x7e, 0x00, 0x00, 0x00, 0x00, 0x7e, 0x00, 0x00, 0x00, 0x00, 0xff,
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    0x00, 0x00, 0x00, 0x00, 0x00, 0x00, 0x00, 0x00};

const GFXbitmapGlyph UpArrowGlyphs[] PROGMEM = {
    {0, 40, 40, 0, '0'} // 'arrow-152-32'
};

const GFXbitmapFont UpArrowFont PROGMEM = {
    (uint8_t *)UpArrowBitmap,
    (GFXbitmapGlyph *)UpArrowGlyphs,
    1};

void setup() {
  //Initialize EEPROM
  EEPROM.begin(512);

  //Initialize the ssid for web server mode
  strcpy(server_ssid,SSID_PREFIX);
  strcat(server_ssid,GUID);

  // Disable WiFi persistent mode to prevent wearing out the flash (we're storing ssid/pass in eeprom anyways)
  WiFi.persistent(false);
  // Ensure we have a consistent state depending on what was stored in the flash
  WiFi.disconnect();
  WiFi.softAPdisconnect();
  //Setup the access point
  WiFi.softAPConfig(apIP, apIP, IPAddress(255, 255, 255, 0));
  WiFi.softAP(server_ssid, SERVER_PASSWORD);

  // if DNSServer is started with "*" for domain name, it will reply with
  // provided IP to all DNS request
  dnsServer.start(DNS_PORT, "*", apIP);

  //Used to nuke the WiFi settings in eeprom
  /*
  char clientSSID[30] = "";
  char clientPassword[30] = "";
  String ssidHTML = "MySSID";
  String passwordHTML = "mypassword";
  strncpy(clientSSID, ssidHTML.c_str(), 30);
  strncpy(clientPassword, passwordHTML.c_str(), 30);
  //Store SSID in EEPROM
  EEPROM.put(1, clientSSID);
  //Store password in EEPROM
  EEPROM.put(31, clientPassword);
  EEPROM.commit();
  */

  //Set up the display
  setupILI9341();

  //Setup the touchscreen
  setupXPT2046();

  //Repurpose GUID pins to I2C bus
  changeSerialtoI2C();

  //Assign bus to sensor
  setI2CBusSensors();

  //Get the selected keg sensors
  //Temporarily disabled until multiple sensors used
  //getfliteSensorSelection();

  //Setup keg sensors
  setupfliteSensors();

  //Assign pointer to selected sensor
  //Temporarily hard coded until multiple sensors is used
  fliteSensorSelected = &fliteSensorBlack;

  //Update the sensor data
  updateSensorData();

  //Connect to the wifi
  connectToWiFi();

  //Enable the web server
  enableWebServer();
}

void loop() {
  MDNS.update();
  delay(1);
  //Increment ms counter
  msCounter = msCounter + 1;

  //At greater than 32399 ms, reset back to 0
  //32400 is the largest value still divisible by 3600 without overruning 32767
  if (msCounter > 32399){
    msCounter = 0;
  }

  //Call the seconds loop every second
  if (msCounter % 1000 == 0){
    secondsLoop();
  }

  //Call web server and click listener loops every 1 ms
  webServerLoop();
  clickListenerLoop();
  yield();
}

void secondsLoop(){
  //Increment seconds counter
  secondsCounter = secondsCounter + 1;

  //At greater than 32399 seconds, reset back to 0
  //32400 is the largest value still divisible by 3600 (1 hours in seconds) without overruning 32767
  if (secondsCounter > 32399){
    secondsCounter = 0;
  }

  //Sample the selected sensor levels every 1 second
  updateSensorData();
  if (sensorSelections[0] == '1'){
    if(averageCountBlack < SENSOR_UPDATE_INTERVAL){
      //Add to the accumulator
      averageAccumulatorBlack += fliteSensorBlack._level;
      //Increment the count
      averageCountBlack++;
   } else {
      //Set the average holder for the next cycle
      averageHolderBlack = averageAccumulatorBlack / averageCountBlack;
      //Reset the count and accumulator
      //averageAccumulatorBlack = 0.0;
      averageAccumulatorBlack = fliteSensorBlack._level;
      //averageCountBlack = 0;
      averageCountBlack = 1;
   }
  }

  //TODO - Add averaging code for other colors if other colors are used

  //Update sensor values based on interval, use modulus operator
  if (secondsCounter % SENSOR_UPDATE_INTERVAL == 0){
    //Only update sensor and display if not in maintenance mode
    if (maintMode == false){
      updateMainDisplay(FLITE_BLUE, averageHolderBlack, fliteSensorSelected->_temperature, fliteSensorSelected->_psi);
      showFooter("Ready...");
    }
  }

  //Update cloud services based on setpoint interval, use modulus operator
  //Convert interval from minutes to seconds
  int updateIntervalSec = CLOUD_UPDATE_INTERVAL * 60;
  if (secondsCounter % updateIntervalSec == 0){
    //Only update cloud services if not in maintenance mode
    if (maintMode == false){
      saveToCloud();
    }
  }

  //Increment countdown every minute
  if (secondsCounter % 60 == 0){
    int minutesUntilUpdate = CLOUD_UPDATE_INTERVAL - ((secondsCounter % updateIntervalSec)/60);
    showHeader(minutesUntilUpdate);
  }
}

void clickListenerLoop(){
  //Display click listeners
  if (ts.tirqTouched()) {
    if (ts.touched()) {
      TS_Point p = ts.getPoint();
      //In touch cal mode, show raw point for display cal
      if(touchCal){
        char coordXMessage[10] = "X: ";
        char pointX[5];
        dtostrf(p.x, 0, 5, pointX);
        strcat(coordXMessage, pointX);
        showFooter(coordXMessage);
        delay(500);

        char coordYMessage[10] = "Y: ";
        char pointY[5];
        dtostrf(p.y, 0, 5, pointY);
        strcat(coordYMessage, pointY);
        showFooter(coordYMessage);
        delay(500);
      }

      //Check to see if "CAL ZERO PSI" has been touched
      if (getTouchX(p.x) > ((DISPLAY_WIDTH - BUTTON_WIDTH)/2) && getTouchX(p.x) < (((DISPLAY_WIDTH - BUTTON_WIDTH)/2) + BUTTON_WIDTH)){
        if (getTouchY(p.y) > 215 && getTouchY(p.y) < 215 + (BUTTON_HEIGHT*2/3)){
          onCalibrateZeroPSITouch();
        }
      }
      
      //Check to see if "HI CAL" has been touched
      if (getTouchX(p.x) > ((DISPLAY_WIDTH - BUTTON_WIDTH)/2) + (BUTTON_WIDTH/2) && getTouchX(p.x) < (((DISPLAY_WIDTH - BUTTON_WIDTH)/2) + BUTTON_WIDTH)){
        if (getTouchY(p.y) > 250 && getTouchY(p.y) < 250 + (BUTTON_HEIGHT/2)){
          //Call function for high cal
          onCalibrateHighTouch();
        }
      }

      //Check to see if "LO CAL" has been touched
      if (getTouchX(p.x) > ((DISPLAY_WIDTH - BUTTON_WIDTH)/2) + (BUTTON_WIDTH/2) && getTouchX(p.x) < (((DISPLAY_WIDTH - BUTTON_WIDTH)/2) + BUTTON_WIDTH)){
        if (getTouchY(p.y) > 250 + (BUTTON_HEIGHT/2) && getTouchY(p.y) < 250 + BUTTON_HEIGHT){
          //Call function for low cal
          onCalibrateLowTouch();
        }
      }

      //Check to see of the status icon has been touched
      if (getTouchX(p.x) > (DISPLAY_WIDTH - 35) && getTouchX(p.x) < (DISPLAY_WIDTH)){
        if (getTouchY(p.y) > 0 && getTouchY(p.y) < 35){
          //Call function exit maint mode
          exitMaintMode();
        }
      }

      //Check to see if the up arrow has been touched
      //tft.fillRect((DISPLAY_WIDTH - BUTTON_WIDTH)/2,250,(BUTTON_WIDTH/4), BUTTON_HEIGHT,ILI9341_GREEN);
      if (getTouchX(p.x) > (DISPLAY_WIDTH - BUTTON_WIDTH)/2 && getTouchX(p.x) < ((DISPLAY_WIDTH - BUTTON_WIDTH)/2) + 50){
        if (getTouchY(p.y) > 250 && getTouchY(p.y) < 300){
          onUpArrowTouch();
        }
      }
    
      //Check to see if the down arrow has been touched
      //tft.fillRect(((DISPLAY_WIDTH - BUTTON_WIDTH)/2) + (BUTTON_WIDTH/4),250,(BUTTON_WIDTH/4), BUTTON_HEIGHT,ILI9341_RED);
      if (getTouchX(p.x) > ((DISPLAY_WIDTH - BUTTON_WIDTH)/2) + (BUTTON_WIDTH/4) && getTouchX(p.x) < ((DISPLAY_WIDTH - BUTTON_WIDTH)/2) + (BUTTON_WIDTH/4) + 50){
        if (getTouchY(p.y) > 250 && getTouchY(p.y) < 300){
          onDownArrowTouch();
        }
      }
    }
  }
}

void webServerLoop(){
  dnsServer.processNextRequest();
  //Listen for HTTP requests from clients
  server.handleClient();
}

void changeSerialtoI2C(){
  //GPIO 1 (TX) swap the pin to a GPIO.
  pinMode(1, FUNCTION_3); 
  //GPIO 3 (RX) swap the pin to a GPIO.
  pinMode(3, FUNCTION_3); 
}

void changeI2CToSerial(){
  //GPIO 1 (TX) swap the pin to a TX.
  pinMode(1, FUNCTION_0); 
  //GPIO 3 (RX) swap the pin to a RX.
  pinMode(3, FUNCTION_0); 
}

void setI2CBusSensors(){
  Wire.begin(SDA, SCL);
}

void setupfliteSensors(){
  //Get the current keg sensors in use
  showFooter("Black: " + String(sensorSelections[0]) + ", Blue: " + String(sensorSelections[1]) + ", Red: " + String(sensorSelections[2]) + ", Green: " + String(sensorSelections[3]));
  if (sensorSelections[0] == '1'){
    setupfliteSensor(fliteSensorBlack, "black");
  }
  if (sensorSelections[1] == '1'){
    setupfliteSensor(fliteSensorBlue, "blue");
  }
  if (sensorSelections[2] == '1'){
    setupfliteSensor(fliteSensorRed, "red");
  }
  if (sensorSelections[3] == '1'){
    setupfliteSensor(fliteSensorGreen, "green");
  }
}

void setupfliteSensor(FliteSensor &fliteSensor, String color){
  if (fliteSensor.beginSensor()){
    showFooter("Successfully began " + color + " sensor");
  } else {
    showFooter("Unsuccessful beginning " + color + " sensor");
  }
  delay(3000);
}

void setupILI9341(){
  // Turn on the background LED
  pinMode(TFT_LED, OUTPUT);
  digitalWrite(TFT_LED, HIGH);

  //Initialize the display
  tft.begin();

  //Show splash screen
  showSplash();

  //Delay 5 seconds to warm sensors up
  delay(5000);

  //Show header, main, and footer
  showHeader(CLOUD_UPDATE_INTERVAL);
  showMainDisplay();
}

void setupXPT2046(){
    ts.begin();
    ts.setRotation(0);
}

//Returns a pixelized version of the TFT input for X
int getTouchX(int rawX){
  //Get the slope and intercept
  float m = (DISPLAY_WIDTH - 0.0) / (MAXIMUM_X - MINIMUM_X);
  float b = DISPLAY_WIDTH - (m * MAXIMUM_X);

  //Calculate the X
  int x = m * rawX + b;
  
  return x;
}

//Returns a pixelized version of the TFT input for Y
int getTouchY(int rawY){
  //Get the slope and intercept
  float m = (DISPLAY_HEIGHT - 0.0) / (MAXIMUM_Y - MINIMUM_Y);
  float b = DISPLAY_HEIGHT - (m * MAXIMUM_Y);

  //Calculate the Y
  int y = m * rawY + b;

  return y;
}

bool isCloudServiceEnabled(){
  bool e = false;

  //If either Flite or Taplist API enabled, cloud servies are enabled
  if(fliteEnabled() || taplistEnabled()){
    e = true;
  }

  return e;
}

//This function connects to the WiFi
void connectToWiFi(){
  //int wifiTimeoutCounter = 0;
  showFooter("Initializing WiFi...");

  //Show WiFi icon
  showWiFiIcon();

  //Attempt to connect if not connected
  if (WiFi.status() != WL_CONNECTED) {
      showFooter("Attempting to connect to WiFi...");
      beginWiFi();
  }

  //Show network settings on display
  showFooter("Retrieving network configuration...");
  
  delay(1000);
  updateDisplayedConfig();

  //Hide WiFi if not in maintenance mode.  If entered maint during WiFi update, dont want to clear the wrench.
  if (maintMode){
    showWrenchIcon();
  } else {
    hideStatusIcon();
  }
}

//This function begins the wifi connection
void beginWiFi(){
  showFooter("Connecting to WiFi, please wait...");
    
  //Configure as AP and STA
  WiFi.mode(WIFI_AP_STA);

  //Connect to the wifi
  WiFi.begin(getWiFiSSID(), getWiFiPassword());
  WiFi.waitForConnectResult();
}

void disconnectFromWiFi(){
  WiFi.disconnect();
}

//Connects to WiFi and updates cloud services
void saveToCloud(){
  //Connect to the WiFi
  connectToWiFi();
  //Make sure cloud services are enabled
  if(isCloudServiceEnabled()){
    if (WiFi.status() == WL_CONNECTED){
      if(taplistEnabled()){
        //Taplist.io API
        saveToTaplist();
      }

      if(fliteEnabled()){
        //Flite API on parse server
        saveToParseServer();
      }
    }
  }
}

//Connect to WiFi, save data to parse server
void saveToParseServer(){
  //Initialize parse SDK with keys
  Parse.begin(getFliteAppID(), getFliteAPIKey());
  Parse.setServerURL("parseapi.back4app.com");
  //Parse.setHostFingerprint("a4117a2ea12d7278e02d72929a3cfb085dffa62e");

  //Use if the API host server fingerprint is not reliable
  Parse.setClientInsecure();

  showFooter("Attempting to log to Flite Cloud DB...");

  //Get the current keg sensors in use
  if (sensorSelections[0] == '1'){
    delay(1000);
    //Call the parse cloud code
    ParseCloudFunction cloudFunctionBlack;
    cloudFunctionBlack.setFunctionName("addBlackFlite");
    cloudFunctionBlack.add("fliteControllerIDBlack", GUID);
    cloudFunctionBlack.add("levelBlack", averageHolderBlack);
    cloudFunctionBlack.add("temperatureBlack", fliteSensorBlack._temperature);
    cloudFunctionBlack.add("pressureBlack", fliteSensorBlack._psi);
    ParseResponse responseBlack = cloudFunctionBlack.send();
    // Free the resource
    responseBlack.close();
  }
  if (sensorSelections[1] == '1'){
    delay(1000);
    //Call the parse cloud code
    ParseCloudFunction cloudFunctionBlue;
    cloudFunctionBlue.setFunctionName("addBlueFlite");
    cloudFunctionBlue.add("fliteControllerIDBlue", GUID);
    //cloudFunctionBlue.add("levelBlue", fliteSensorBlue._level);
    cloudFunctionBlue.add("temperatureBlue", fliteSensorBlue._temperature);
    cloudFunctionBlue.add("pressureBlue", fliteSensorBlue._psi);
    ParseResponse responseBlue = cloudFunctionBlue.send();
    // Free the resource
    responseBlue.close();
  }
  if (sensorSelections[2] == '1'){
    delay(1000);
    //Call the parse cloud code
    ParseCloudFunction cloudFunctionRed;
    cloudFunctionRed.setFunctionName("addRedFlite");
    cloudFunctionRed.add("fliteControllerIDRed", GUID);
    //cloudFunctionRed.add("levelRed", fliteSensorRed._level);
    cloudFunctionRed.add("temperatureRed", fliteSensorRed._temperature);
    cloudFunctionRed.add("pressureRed", fliteSensorRed._psi);
    ParseResponse responseRed = cloudFunctionRed.send();
    // Free the resource
    responseRed.close();
  }
  if (sensorSelections[3] == '1'){
    delay(1000);
    //Call the parse cloud code
    ParseCloudFunction cloudFunctionGreen;
    cloudFunctionGreen.setFunctionName("addGreenFlite");
    cloudFunctionGreen.add("fliteControllerIDGreen", GUID);
    //cloudFunctionGreen.add("levelGreen", fliteSensorGreen._level);
    cloudFunctionGreen.add("temperatureGreen", fliteSensorGreen._temperature);
    cloudFunctionGreen.add("pressureGreen", fliteSensorGreen._psi);
    ParseResponse responseGreen = cloudFunctionGreen.send();
    // Free the resource
    responseGreen.close();
  }
}

//Returns the mount served in mL, assuming a 5 gal keg, with remaining gal provided
int getmLServedFromGal(float gal){
  float servedGal = 5 - gal;
  int mlServed = servedGal * 3785;
  return mlServed;
}

//Returns the temperature in Deg.C with Deg.F provided
float degFtodegC(float degF){
  float degC = (degF - 32) * 5/9;
  return degC;
}

//Only supports BLACK sensor at this time!
void saveToTaplist(){

  showFooter("Attempting to log to Taplist.io...");

  std::unique_ptr<BearSSL::WiFiClientSecure>secureClient(new BearSSL::WiFiClientSecure);
  //This works if you have the cert
  //secureClient->setFingerprint("39:1F:3E:52:C6:60:5F:7C:0A:3E:56:F7:CB:94:51:75:14:18:E9:91");
  //This works if you dont...
  secureClient->setInsecure();

  HTTPClient httpClient;

  String url = "https://api.taplist.io/api/v1/venues/";
  url += getTaplistVenueID();
  url += "/taps/";
  url += getTaplistTapID();
  url += "/current-keg";

  httpClient.begin(*secureClient, url);
  httpClient.addHeader("Authorization", getTaplistAPIKey());
  httpClient.addHeader("Content-Type", "application/json");

  //Convert level and temp to mL served and Deg.C
  //Convert all values to char
  char levelString[6];
  int servedMl = getmLServedFromGal(averageHolderBlack);
  //int servedMl = getmLServedFromGal(fliteSensorBlack._level);
  dtostrf(servedMl, 1, 1, levelString);
  char temperatureString[6];
  float tempC = farenheitToCelsius(fliteSensorBlack._temperature);
  dtostrf(tempC, 1, 1, temperatureString);
  char pressureString[6];
  dtostrf(fliteSensorBlack._psi, 1, 1, pressureString);

  String patch = "{\"served_volume_ml\":\"";
  patch += levelString;
  patch += "\", \"temperature_c\":\"";
  patch += temperatureString;
  patch += "\", \"pressure_psi\":\"";
  patch += pressureString;
  patch += "\", \"full_volume_ml\":\"18927\"}";
  
  int httpCode = httpClient.PATCH(patch); 
  if (httpCode > 0) {
    if (httpCode == HTTP_CODE_OK) {
      showFooter("Successfully updated taplist API!");
    } else {
      showFooter("Error updating taplist API: " + httpCode);
    }
  }
  httpClient.end();
}

void showSplash(){
  tft.fillScreen(FLITE_GREY);
  tft.drawBitmap(20,20,FliteBitmap,200,200,FLITE_BLUE);
  tft.setCursor(70,250);
  tft.setTextColor(FLITE_BLUE);
  tft.setTextSize(2);
  tft.println("Loading...");
}

//This function shows the main display
void showMainDisplay(){
  showFooter("Showing main display...");
  tft.drawRect(0,35,DISPLAY_WIDTH,DISPLAY_HEIGHT - 35,FLITE_GREY);
  tft.fillRect(0,35,DISPLAY_WIDTH,DISPLAY_HEIGHT - 35,FLITE_GREY);
  updateMainDisplay(FLITE_BLUE, 0.0, 0.0, 0.0);
  tft.println();
  tft.setTextColor(ILI9341_WHITE);
  tft.setTextSize(2);
  tft.print("ID: ");
  tft.println(GUID);
  tft.setTextColor(ILI9341_WHITE);
  tft.setTextSize(2);
  tft.print("Version: ");
  tft.println(CODE_VERSION);

  //Draw configuration
  updateDisplayedConfig();

  //Draw calibrate zero psi button
  tft.fillRect((DISPLAY_WIDTH - BUTTON_WIDTH)/2,215,BUTTON_WIDTH, (BUTTON_HEIGHT*2/3),ILI9341_WHITE);
  tft.drawRect((DISPLAY_WIDTH - BUTTON_WIDTH)/2,215,BUTTON_WIDTH, (BUTTON_HEIGHT*2/3),ILI9341_BLACK);
  tft.setCursor((DISPLAY_WIDTH - BUTTON_WIDTH)/2 + 26, 215 + 10);
  tft.setTextColor(ILI9341_BLACK);
  tft.setTextSize(2);
  tft.println("CAL ZERO PSI");

  //Draw cal hi button
  tft.fillRect(((DISPLAY_WIDTH - BUTTON_WIDTH)/2) + (BUTTON_WIDTH/2),250,(BUTTON_WIDTH/2), (BUTTON_HEIGHT/2),ILI9341_WHITE);
  tft.drawRect(((DISPLAY_WIDTH - BUTTON_WIDTH)/2) + (BUTTON_WIDTH/2),250,(BUTTON_WIDTH/2), (BUTTON_HEIGHT/2),ILI9341_BLACK);
  tft.setCursor(((DISPLAY_WIDTH - BUTTON_WIDTH)/2) + (BUTTON_WIDTH/2) + 15, 250 + 6);
  tft.setTextColor(ILI9341_BLACK);
  tft.setTextSize(2);
  tft.println("CAL HI");

  //Draw cal lo button
  tft.fillRect(((DISPLAY_WIDTH - BUTTON_WIDTH)/2) + (BUTTON_WIDTH/2),250 + (BUTTON_HEIGHT/2),(BUTTON_WIDTH/2), (BUTTON_HEIGHT/2),ILI9341_WHITE);
  tft.drawRect(((DISPLAY_WIDTH - BUTTON_WIDTH)/2) + (BUTTON_WIDTH/2),250 + (BUTTON_HEIGHT/2),(BUTTON_WIDTH/2), (BUTTON_HEIGHT/2),ILI9341_BLACK);
  tft.setCursor(((DISPLAY_WIDTH - BUTTON_WIDTH)/2) + (BUTTON_WIDTH/2) + 15, 250 + (BUTTON_HEIGHT/2) + 6);
  tft.setTextColor(ILI9341_BLACK);
  tft.setTextSize(2);
  tft.println("CAL LO");

  //Draw up arrow button
  tft.drawBitmap(((DISPLAY_WIDTH - BUTTON_WIDTH)/2) + 5,255,UpArrowBitmap,40,40,ILI9341_WHITE);

  //Draw down arrow button
  tft.drawBitmap(((DISPLAY_WIDTH - BUTTON_WIDTH)/2) + (BUTTON_WIDTH/4) + 5,255,DownArrowBitmap,40,40,ILI9341_WHITE);
}

//This function is called to update the level and temp on the display
void updateMainDisplay(int color, float l, float t, float p){
  tft.fillRect(0,40,DISPLAY_WIDTH,80,FLITE_GREY);
  tft.setCursor(0, 40);
  tft.setTextColor(color);
  //If metric units are selected
  if(metricUnitsEnabled()){
    tft.setTextSize(3);
    char levelString[4];
    dtostrf(gallonsToLiters(l), 1, 1, levelString);
    tft.print(levelString);
    tft.println(" Ltr");
    tft.setTextColor(color);
    char temperatureString[5];
    dtostrf(farenheitToCelsius(t), 1, 1, temperatureString);
    tft.print(temperatureString);
    tft.println(" DegC");
    char pressureString[5];
    dtostrf(psiTokPa(p), 1, 1, pressureString);
    tft.print(pressureString);
    tft.println(" kPa");
  } else {
    tft.setTextSize(4);
    char levelString[4];
    dtostrf(l, 1, 1, levelString);
    tft.print(levelString);
    tft.println(" GAL");
    tft.setTextColor(color);
    tft.setTextSize(3);
    char temperatureString[5];
    dtostrf(t, 1, 1, temperatureString);
    tft.print(temperatureString);
    tft.println(" DegF");
    char pressureString[5];
    dtostrf(p, 1, 1, pressureString);
    tft.print(pressureString);
    tft.println(" PSI");
  }
  updateKegDisplay(l);
}

float gallonsToLiters(float liters){
  float gallons = liters * 3.7854;
  return gallons;
}

float farenheitToCelsius(float farenheit){
  float celsius = (farenheit - 32) / 1.8;
  return celsius;
}

float psiTokPa(float psi){
  float kPa = psi * 6.895;
  return kPa;
}

//This function updates the displayed configuration
void updateDisplayedConfig(){
  //Draw the frame for the calibration and IP address settings
  tft.fillRect(5, 180, DISPLAY_WIDTH - 10, 30, FLITE_GREY);
  tft.drawRect(5, 180, DISPLAY_WIDTH - 10, 30, ILI9341_WHITE);

  //Display network and calibration settings
  updateDisplayedNetwork();
  updateDisplayedCalibration();
}

//This function updates the displayed network settings
void updateDisplayedNetwork(){
  tft.fillRect(10, 181, DISPLAY_WIDTH - 20, 9, FLITE_GREY);
  tft.setCursor(10,182);
  tft.setTextColor(ILI9341_WHITE);
  tft.setTextSize(1);
  tft.print("WiFi: ");
  //tft.println(ip2CharArray(WiFi.localIP()));
  if(WiFi.status() == WL_CONNECTED) {
      // Connected to WiFi - Print the stored SSID & current IP address
      tft.print(getWiFiSSID());
      tft.print(" ");
      tft.print("IP: ");
      tft.println(WiFi.localIP().toString().c_str());
  } else {
      // NOT Connected to WiFi - Print the softAP IP address
      tft.print(server_ssid);
      tft.print(" ");
      tft.print("IP: ");
      tft.println(WiFi.softAPIP().toString().c_str());
  }
}

//This function updates the displayed calibration settings
void updateDisplayedCalibration(){
  char pressureOffset[5];
  char levelLowCal[5];
  char levelHighCal[5];
  char distanceLowCal[5];
  char distanceHighCal[5];

  tft.fillRect(10, 191, DISPLAY_WIDTH - 20, 18, FLITE_GREY);
  tft.setCursor(10,191);
  tft.setTextColor(ILI9341_WHITE);
  tft.setTextSize(1);

  if(metricUnitsEnabled()){
    tft.print("Liters: ");
    dtostrf(gallonsToLiters(fliteSensorBlack.getCalibrationLevelLow()), 1, 1, levelLowCal);
    tft.print(levelLowCal);
    tft.print("-");
    dtostrf(gallonsToLiters(fliteSensorBlack.getCalibrationLevelHigh()), 1, 1, levelHighCal);
    tft.print(levelHighCal);
    tft.print(" Distance: ");
    dtostrf(fliteSensorBlack.getCalibrationDistanceLow(), 0, 0, distanceLowCal);
    tft.print(distanceLowCal);
    tft.print("-");
    dtostrf(fliteSensorBlack.getCalibrationDistanceHigh(), 0, 0, distanceHighCal);
    tft.println(distanceHighCal);
    tft.setCursor(10,200);
    tft.setTextColor(ILI9341_WHITE);
    tft.setTextSize(1);
    tft.print("Pressure Offset: ");
    dtostrf(psiTokPa(fliteSensorBlack.getCalibrationZeroPSI()), 1, 1, pressureOffset);
    tft.print(pressureOffset);
    tft.println(" kPa");
  } else {
    tft.print("Gallons: ");
    dtostrf(fliteSensorBlack.getCalibrationLevelLow(), 1, 1, levelLowCal);
    tft.print(levelLowCal);
    tft.print("-");
    dtostrf(fliteSensorBlack.getCalibrationLevelHigh(), 1, 1, levelHighCal);
    tft.print(levelHighCal);
    tft.print(" Distance: ");
    dtostrf(fliteSensorBlack.getCalibrationDistanceLow(), 0, 0, distanceLowCal);
    tft.print(distanceLowCal);
    tft.print("-");
    dtostrf(fliteSensorBlack.getCalibrationDistanceHigh(), 0, 0, distanceHighCal);
    tft.println(distanceHighCal);
    tft.setCursor(10,200);
    tft.setTextColor(ILI9341_WHITE);
    tft.setTextSize(1);
    tft.print("Pressure Offset: ");
    dtostrf(fliteSensorBlack.getCalibrationZeroPSI(), 1, 1, pressureOffset);
    tft.print(pressureOffset);
    tft.println(" PSI");
  }
}

//This function updates the keg animation
void updateKegDisplay(float l){
  tft.fillRect(170,35,65,140,FLITE_GREY);
  tft.drawRect(170,35,65,140,ILI9341_WHITE);
  //Calculate the height of the fill based on the gallons provided
  //Keg height range 0-5 gallons is 0-130 pixels
  int fillPixels = (5 - l) * 26;
  tft.fillRect(175,(40 + fillPixels),55,(130 - fillPixels),KEG_FILL);
}

//This function updates the header message
void showHeader(int i){
  tft.fillRect(0,0,DISPLAY_WIDTH - 40,20,FLITE_GREY);
  tft.drawRect(0,0,DISPLAY_WIDTH - 40,20,ILI9341_WHITE);
  tft.setCursor(5,7);
  tft.setTextColor(ILI9341_WHITE);
  tft.setTextSize(1);
  if(isCloudServiceEnabled()){
    tft.print("Cloud Update In ");
    tft.print(i);
    tft.println(" Minutes...");
  } else {
    tft.println("Cloud services not configured.");
  }
}

//This function updates the footer message
void showFooter(String s){
  //Only show if debugging
  if (debug){
    tft.fillRect(0,DISPLAY_HEIGHT - 17,DISPLAY_WIDTH,17,FLITE_GREY);
    tft.setCursor(5,DISPLAY_HEIGHT - 17);
    tft.setTextColor(ILI9341_YELLOW);
    tft.setTextSize(1);
    tft.println(s);
  }
}

//This function shows the WiFi status icon
void showWiFiIcon(){
  tft.drawBitmap(DISPLAY_WIDTH - 35,0,WiFiIconBitmap,35,35,FLITE_BLUE);
}

//This function enters maint mode
void enterMaintMode(){
    showFooter("Entering maintenance mode...");
    //Hide any icon animated
    hideStatusIcon();
    //Show wrench icon
    showWrenchIcon();
    //Toggle maintMode flag true
    maintMode = true;
}

//This function exits maint mode
void exitMaintMode(){
    showFooter("Exiting maintenance mode...");
    //Hide any icon animated
    hideStatusIcon();
    //Toggle maintMode flag false
    maintMode = false;
}

//This function shows the Wrench status icon
void showWrenchIcon(){
  tft.drawBitmap(DISPLAY_WIDTH - 35,0,WrenchIconBitmap,35,35,FLITE_BLUE);
}

//This function hides the status icon
void hideStatusIcon(){
  tft.drawRect(DISPLAY_WIDTH - 35,0,35,35,FLITE_GREY);
  tft.fillRect(DISPLAY_WIDTH - 35,0,35,35,FLITE_GREY);
}

//This function is called when the up arrow is touched
void onUpArrowTouch(){
  if (maintMode == false){
    //Enter maintenance mode
    enterMaintMode();
  }

  //Set the holder to the current level
  levelHolder = fliteSensorSelected->_level;
  //Increment the level holder by 0.1
  levelHolder += 0.1;
  //Limit level reading from 0-5 (Gallons) or 0-19 (Liters)
  if (levelHolder < 0.0){
    levelHolder = 0.0;
  }
  if(metricUnitsEnabled()){
    if (levelHolder > 19.0){
      levelHolder = 19.0;
    }
  } else {
    if (levelHolder > 5.0){
      levelHolder = 5.0;
    }
  }
  //Set the level to the holder
  fliteSensorSelected->_level = levelHolder;

  //Call function to display the holder value
  updateMainDisplay(ILI9341_RED, fliteSensorSelected->_level, fliteSensorSelected->_temperature, fliteSensorSelected->_psi);
}

//This function is called when the down arrow is touched
void onDownArrowTouch(){
  if (maintMode == false){
    //Enter maintenance mode
    enterMaintMode();
  }

  //Set the holder to the current level
  levelHolder = fliteSensorSelected->_level;
  //Decrement the level holder by 0.1
  levelHolder -= 0.1;
  //Limit level reading from 0-5 (Gallons) or 0-19 (Liters)
  if (levelHolder < 0.0){
    levelHolder = 0.0;
  }
  if(metricUnitsEnabled()){
    if (levelHolder > 19.0){
      levelHolder = 19.0;
    }
  } else {
    if (levelHolder > 5.0){
      levelHolder = 5.0;
    }
  }
  //Set the level to the holder
  fliteSensorSelected->_level = levelHolder;

  //Call function to display the holder value
  updateMainDisplay(ILI9341_RED, fliteSensorSelected->_level, fliteSensorSelected->_temperature, fliteSensorSelected->_psi);
}

//Store zero PSI calibration setting for selected sensor
void onCalibrateZeroPSITouch(){
  showFooter("Storing zero PSI calibration...");
  fliteSensorSelected->calibrateZeroPSI();
  //Update displayed calibration settings
  updateDisplayedConfig();
}

//Store high calibration settings for selected sensor
void onCalibrateHighTouch(){
  showFooter("Storing high level calibration...");
  fliteSensorSelected->calibrateHigh(levelHolder);
  //Update displayed calibration settings
  updateDisplayedConfig();
}

//Store low calibration settings for selected sensor
void onCalibrateLowTouch(){
  showFooter("Storing low level calibration...");
  fliteSensorSelected->calibrateLow(levelHolder);
  //Update displayed calibration settings
  updateDisplayedConfig();
}

//This function reads the sensor data and updates the global variables
void updateSensorData(){
  //Get the current keg sensors in use
  if (sensorSelections[0] == '1'){
    //showFooter("Reading Black sensor data...");
    fliteSensorBlack.getLevel();
    fliteSensorBlack.getTemperature();
    fliteSensorBlack.getPressure();
  }
  if (sensorSelections[1] == '1'){
    //showFooter("Reading Blue sensor data...");
    fliteSensorBlue.getLevel();
    fliteSensorBlue.getTemperature();
    fliteSensorBlue.getPressure();
  }
  if (sensorSelections[2] == '1'){
    //showFooter("Reading Red sensor data...");
    fliteSensorRed.getLevel();
    fliteSensorRed.getTemperature();
    fliteSensorRed.getPressure();
  }
  if (sensorSelections[3] == '1'){
    //showFooter("Reading Green sensor data...");
    fliteSensorGreen.getLevel();
    fliteSensorGreen.getTemperature();
    fliteSensorGreen.getPressure();
  }
}

//This function enables the web server
void enableWebServer(){
  //Toggle web server bool true
  webServerOn = true;

  //Specify mode to console
  showFooter("Initializing web server...");

  //Setup mDNS
  if (!MDNS.begin(GUID)){
    showFooter("Error setting up mDNS");
    while (1) {
      delay(1000);
    }
  }
  showFooter("mDNS Started...");
  delay(1000);

/*
  //Call the 'handleRoot' function when a client requests URI "/"
  server.on("/", handleRoot);
  //When a client requests an unknown URI (i.e. something other than "/"), call function "handleNotFound"               
  server.onNotFound(handleNotFound);
  */

  //Handle HTML responses
  server.onNotFound([]() {
    //server.send(200, "text/html", responseHTML);
    handleRoot();
  });
  
  //When the user updates their network settings or API configurations
  server.on("/updateWiFi", HTTP_POST, handleUpdateWiFiSettings);
  server.on("/testWiFi", HTTP_POST, handleTestWiFiSettings);
  server.on("/updateUnits", HTTP_POST, handleUpdateUnits);
  server.on("/zeroPressure", HTTP_POST, handleZeroPressure);
  server.on("/highCalibration", HTTP_POST, handleHighCalibration);
  server.on("/lowCalibration", HTTP_POST, handleLowCalibration);
  server.on("/updateFliteAPIKeys", HTTP_POST, handleUpdateFliteAPIKeys);
  server.on("/updateTaplistAPI", HTTP_POST, handleUpdateTaplistAPIKeys);

  //Flite controller REST API server
  //This allows 3rd party controllers to get sensor data via http get requests
  server.on("/getControllerInfo", HTTP_GET, getControllerInfo);
  server.on("/getSensorsSelected", HTTP_GET, getSensorSelection);
  server.on("/getSensorsUpdateInterval", HTTP_GET, getSensorsUpdateInterval);

  //Serve the current level, temperature, and pressure for the corrseponding sensor
  server.on("/getValuesBlack", HTTP_GET, getValuesBlack);
  server.on("/getValuesBlue", HTTP_GET, getValuesBlue);
  server.on("/getValuesRed", HTTP_GET, getValuesRed);
  server.on("/getValuesGreen", HTTP_GET, getValuesGreen);

  //Serve the zero pressure offset for the corrseponding sensor
  server.on("/getZeroPressureBlack", HTTP_GET, getZeroPressureBlack);
  server.on("/getZeroPressureBlue", HTTP_GET, getZeroPressureBlue);
  server.on("/getZeroPressureRed", HTTP_GET, getZeroPressureRed);
  server.on("/getZeroPressureGreen", HTTP_GET, getZeroPressureGreen);

  //Serve the level calibration coefficients for the corresponding sensor
  server.on("/getLevelCalBlack", HTTP_GET, getLevelCalBlack);
  server.on("/getLevelCalBlue", HTTP_GET, getLevelCalBlue);
  server.on("/getLevelCalRed", HTTP_GET, getLevelCalRed);
  server.on("/getLevelCalGreen", HTTP_GET, getLevelCalGreen);

  //Start the web server
  server.begin();
  showFooter("HTTP server started...");

  delay(1000);

  // Add service to MDNS-SD
  MDNS.addService("http", "tcp", 80);
  MDNS.addService("flite", "tcp", 80);
  showFooter("mDNS service started...");
}

//Serve controller info
void getControllerInfo() {
  char message[100];
  strcpy(message, "{\"id\": \"");
  strcat(message, GUID);
  strcat(message, "\", \"version\": \"");
  strcat(message, CODE_VERSION);
  strcat(message, "\"}");
  server.send(200, "text/json", message);
}

//Serve sensors selected
void getSensorSelection() {
    char message[100];
    strcpy(message, "{\"black\": ");
    if (sensorSelections[0] == '1') strcat(message, "true"); else strcat(message, "false");
    strcat(message, ", \"blue\": ");
    if (sensorSelections[1] == '1') strcat(message, "true"); else strcat(message, "false");
    strcat(message, ", \"red\": ");
    if (sensorSelections[2] == '1') strcat(message, "true"); else strcat(message, "false");
    strcat(message, ", \"green\": ");
    if (sensorSelections[3] == '1') strcat(message, "true"); else strcat(message, "false");
    strcat(message, "}");
    server.send(200, "text/json", message);
}

//Serve update interval
void getSensorsUpdateInterval() {
  char message[100];
  strcpy(message, "{\"interval\": \"");
  char updateIntervalString[4];
  dtostrf(SENSOR_UPDATE_INTERVAL, 1, 0, updateIntervalString);
  strcat(message, updateIntervalString);
  strcat(message, "\", \"units\": \"seconds\"}");
  server.send(200, "text/json", message);
}

//Serve black sensor current values
void getValuesBlack() {
  //float l = fliteSensorBlack._level;
  float l = averageHolderBlack;
  float t = fliteSensorBlack._temperature;
  float p = fliteSensorBlack._psi;
  getValues(l, t, p);
}

//Serve blue sensor current values
void getValuesBlue() {
  float l = fliteSensorBlue._level;
  float t = fliteSensorBlue._temperature;
  float p = fliteSensorBlue._psi;
  getValues(l, t, p);
}

//Serve red sensor current values
void getValuesRed() {
  float l = fliteSensorRed._level;
  float t = fliteSensorRed._temperature;
  float p = fliteSensorRed._psi;
  getValues(l, t, p);
}

//Serve green sensor current values
void getValuesGreen() {
  float l = fliteSensorGreen._level;
  float t = fliteSensorGreen._temperature;
  float p = fliteSensorGreen._psi;
  getValues(l, t, p);
}

//Serve the values as a formatted JSON
void getValues(float l, float t, float p){
  char message[200];
  if(metricUnitsEnabled()){
    strcpy(message, "{\"level\": \"");
    char levelString[4];
    dtostrf(gallonsToLiters(l), 1, 1, levelString);
    strcat(message, levelString);
    strcat(message, "\", \"levelUnits\": \"Liters\", \"temperature\": \"");
    char temperatureString[5];
    dtostrf(farenheitToCelsius(t), 1, 1, temperatureString);
    strcat(message, temperatureString);
    strcat(message, "\", \"temperatureUnits\": \"DegC\", \"pressure\": \"");
    char pressureString[5];
    dtostrf(psiTokPa(p), 1, 1, pressureString);
    strcat(message, pressureString);
    strcat(message, "\", \"pressureUnits\": \"kPa\"}");
  } else {
    strcpy(message, "{\"level\": \"");
    char levelString[4];
    dtostrf(l, 1, 1, levelString);
    strcat(message, levelString);
    strcat(message, "\", \"levelUnits\": \"Gallons\", \"temperature\": \"");
    char temperatureString[5];
    dtostrf(t, 1, 1, temperatureString);
    strcat(message, temperatureString);
    strcat(message, "\", \"temperatureUnits\": \"DegF\", \"pressure\": \"");
    char pressureString[5];
    dtostrf(p, 1, 1, pressureString);
    strcat(message, pressureString);
    strcat(message, "\", \"pressureUnits\": \"PSI\"}");
  }
  server.send(200, "text/json", message);
}

//Serve black sensor zero pressure offset
void getZeroPressureBlack() {
  float p = fliteSensorBlack.getCalibrationZeroPSI();
  getZeroPressure(p);
}

//Serve blue sensor zero pressure offset
void getZeroPressureBlue() {
  float p = fliteSensorBlue.getCalibrationZeroPSI();
  getZeroPressure(p);
}

//Serve red sensor zero pressure offset
void getZeroPressureRed() {
  float p = fliteSensorRed.getCalibrationZeroPSI();
  getZeroPressure(p);
}

//Serve green sensor zero pressure offset
void getZeroPressureGreen() {
  float p = fliteSensorGreen.getCalibrationZeroPSI();
  getZeroPressure(p);
}

//Serve zero pressure as formatted JSON
void getZeroPressure(float p){
  char message[100];
  if(metricUnitsEnabled()){
    strcpy(message, "{\"pressure\": \"");
    char pressureString[5];
    dtostrf(psiTokPa(p), 1, 1, pressureString);
    strcat(message, pressureString);
    strcat(message, "\", \"pressureUnits\": \"kPa\"}");
  } else {
    strcpy(message, "{\"pressure\": \"");
    char pressureString[5];
    dtostrf(p, 1, 1, pressureString);
    strcat(message, pressureString);
    strcat(message, "\", \"pressureUnits\": \"PSI\"}");
  }
  server.send(200, "text/json", message);
}

//Serve black sensor level calibration coefficients
void getLevelCalBlack() {
  float lowEU = fliteSensorBlack.getCalibrationLevelLow();
  float highEU = fliteSensorBlack.getCalibrationLevelHigh();
  float lowDistance = fliteSensorBlack.getCalibrationDistanceLow();
  float highDistance = fliteSensorBlack.getCalibrationDistanceHigh();
  getLevelCal(lowEU, highEU, lowDistance, highDistance);
}

//Serve blue sensor level calibration coefficients
void getLevelCalBlue() {
  float lowEU = fliteSensorBlue.getCalibrationLevelLow();
  float highEU = fliteSensorBlue.getCalibrationLevelHigh();
  float lowDistance = fliteSensorBlue.getCalibrationDistanceLow();
  float highDistance = fliteSensorBlue.getCalibrationDistanceHigh();
  getLevelCal(lowEU, highEU, lowDistance, highDistance);
}

//Serve red sensor level calibration coefficients
void getLevelCalRed() {
  float lowEU = fliteSensorRed.getCalibrationLevelLow();
  float highEU = fliteSensorRed.getCalibrationLevelHigh();
  float lowDistance = fliteSensorRed.getCalibrationDistanceLow();
  float highDistance = fliteSensorRed.getCalibrationDistanceHigh();
  getLevelCal(lowEU, highEU, lowDistance, highDistance);
}

//Serve green sensor level calibration coefficients
void getLevelCalGreen() {
  float lowEU = fliteSensorGreen.getCalibrationLevelLow();
  float highEU = fliteSensorGreen.getCalibrationLevelHigh();
  float lowDistance = fliteSensorGreen.getCalibrationDistanceLow();
  float highDistance = fliteSensorGreen.getCalibrationDistanceHigh();
  getLevelCal(lowEU, highEU, lowDistance, highDistance);
}

//Serve level calibration as a formatted JSON
void getLevelCal(float lowEU, float highEU, float lowDistance, float highDistance){
  char message[200];
  if(metricUnitsEnabled()){
    strcpy(message, "{\"levelLow\": \"");
    char levelLowString[4];
    dtostrf(gallonsToLiters(lowEU), 1, 1, levelLowString);
    strcat(message, levelLowString);
    strcat(message, "\", \"levelHigh\": \"");
    char levelHighString[4];
    dtostrf(gallonsToLiters(highEU), 1, 1, levelHighString);
    strcat(message, levelHighString);
    strcat(message, "\", \"levelUnits\": \"Liters\", \"distanceLow\": \"");
    char distanceLowString[6];
    dtostrf(lowDistance, 1, 1, distanceLowString);
    strcat(message, distanceLowString);
    strcat(message, "\", \"distanceHigh\": \"");
    char distanceHighString[6];
    dtostrf(highDistance, 1, 1, distanceHighString);
    strcat(message, distanceHighString);
    strcat(message, "\", \"distanceUnits\": \"mm\"}");
  } else {
    strcpy(message, "{\"levelLow\": \"");
    char levelLowString[4];
    dtostrf(lowEU, 1, 1, levelLowString);
    strcat(message, levelLowString);
    strcat(message, "\", \"levelHigh\": \"");
    char levelHighString[4];
    dtostrf(highEU, 1, 1, levelHighString);
    strcat(message, levelHighString);
    strcat(message, "\", \"levelUnits\": \"Gallons\", \"distanceLow\": \"");
    char distanceLowString[6];
    dtostrf(lowDistance, 1, 1, distanceLowString);
    strcat(message, distanceLowString);
    strcat(message, "\", \"distanceHigh\": \"");
    char distanceHighString[6];
    dtostrf(highDistance, 1, 1, distanceHighString);
    strcat(message, distanceHighString);
    strcat(message, "\", \"distanceUnits\": \"mm\"}");
  }
  server.send(200, "text/json", message);
}

//Send HTTP status 200 (Ok) and send some text to the browser/client
void handleRoot() {
  String htmlContent = "";
  htmlContent += F("<html lang='fr'><head><meta http-equiv='refresh' content='60' name='viewport' content='width=device-width, initial-scale=1'/>");
  htmlContent += F("<link rel='stylesheet' href='https://maxcdn.bootstrapcdn.com/bootstrap/4.5.2/css/bootstrap.min.css'><script src='https://ajax.googleapis.com/ajax/libs/jquery/3.1.1/jquery.min.js'></script><script src='https://maxcdn.bootstrapcdn.com/bootstrap/3.3.7/js/bootstrap.min.js'></script>");
  htmlContent += F("<title>Flite Configuration</title></head><body>");
  htmlContent += F("<!DOCTYPE html>");
  htmlContent += F("<body style=\"background-color:#ffffff;\">");
  htmlContent += F("<div class=\"container\">");
  htmlContent += F("<div class=\"row\">");
  htmlContent += F("<div class=\"col\">");
  htmlContent += F("<h1 style=\"background-color:#5d5d5d;\">");
  htmlContent += F("<p style=\"color:#60b0f4;\">Flite Controller Configuration</p>");
  htmlContent += F("<p style=\"color:#60b0f4;\">Firmware Version: ");
  htmlContent += FPSTR(CODE_VERSION);
  htmlContent += F("</p>");
  htmlContent += F("<p style=\"color:#60b0f4;\">ID: ");
  htmlContent += FPSTR(GUID);
  htmlContent += F("</p>");
  htmlContent += F("</h1>");
  htmlContent += F("</div>");
  htmlContent += F("</div>");

  htmlContent += F("<div class=\"row\">");
  
  htmlContent += F("<div class=\"col-2\">");
  htmlContent += F("<canvas id=\"kegCanvas\" width=\"65\" height=\"140\" style=\"border:1px solid #d3d3d3;\">");
  htmlContent += F("<script>");
  htmlContent += F("var c = document.getElementById(\"kegCanvas\");");
  htmlContent += F("var ctx = c.getContext(\"2d\");");
  htmlContent += F("ctx.fillStyle = \"#CFA200\";");
  //Calculate the height of the fill based on the gallons provided
  //Keg height range 0-5 gallons is 0-130 pixels
  //float l = fliteSensorSelected->_level;
  float l = averageHolderBlack;
  int fillPixels = (5 - l) * 26;
  int fillTop = 5 + fillPixels;
  char top[4];
  dtostrf(fillTop, 1, 0, top);
  int fillHeight = 130 - fillPixels;
  char height[4];
  dtostrf(fillHeight, 1, 0, height);
  htmlContent += F("ctx.fillRect(5, ");
  htmlContent += FPSTR(top);
  htmlContent += F(", 55, ");
  htmlContent += FPSTR(height);
  htmlContent += F(");");
  htmlContent += F("</script>");
  
  htmlContent += F("</div>");
  
  htmlContent += F("<div class=\"col\">");

  //If metric units are selected
  if(metricUnitsEnabled()){
    char levelString[4];
    //dtostrf(gallonsToLiters(fliteSensorSelected->_level), 1, 1, levelString);
    dtostrf(gallonsToLiters(averageHolderBlack), 1, 1, levelString);
    htmlContent += F("<h2><p>");
    htmlContent += FPSTR(levelString);
    htmlContent += F(" Liters</p></h2>");
    char temperatureString[5];
    dtostrf(farenheitToCelsius(fliteSensorSelected->_temperature), 1, 1, temperatureString);
    htmlContent += F("<h2><p>");
    htmlContent += FPSTR(temperatureString);
    htmlContent += F(" Deg.C</p></h2>");
    char pressureString[5];
    dtostrf(psiTokPa(fliteSensorSelected->_psi), 1, 1, pressureString);
    htmlContent += F("<h2><p>");
    htmlContent += FPSTR(pressureString);
    htmlContent += F(" kPa</p></h2>");
  } else {
    char levelString[4];
    //dtostrf(fliteSensorSelected->_level, 1, 1, levelString);
    dtostrf(averageHolderBlack, 1, 1, levelString);
    htmlContent += F("<h2><p>");
    htmlContent += FPSTR(levelString);
    htmlContent += F(" GAL</p></h2>");
    char temperatureString[5];
    dtostrf(fliteSensorSelected->_temperature, 1, 1, temperatureString);
    htmlContent += F("<h2><p>");
    htmlContent += FPSTR(temperatureString);
    htmlContent += F(" Deg.F</p></h2>");
    char pressureString[5];
    dtostrf(fliteSensorSelected->_psi, 1, 1, pressureString);
    htmlContent += F("<h2><p>");
    htmlContent += FPSTR(pressureString);
    htmlContent += F(" PSI</p></h2>");
  }
  htmlContent += F("</div>");
  
  htmlContent += F("</div>");

  htmlContent += F("<div class=\"row\">");
  htmlContent += F("<div class=\"col\">");
  htmlContent += F("<h1 style=\"background-color:#60b0f4;\">");
  htmlContent += F("<p style=\"color:#5d5d5d;\">CALIBRATION</p>");
  htmlContent += F("</h1>");
  htmlContent += F("</div>");
  htmlContent += F("</div>");

  htmlContent += F("<div class=\"row\">");
  htmlContent += F("<div class=\"col\">");

  htmlContent += F("<h4><p><b>Displayed Units</b></p></h4>");
  htmlContent += F("<h5>");
  htmlContent += F("<form action=\"/updateUnits\" method=\"POST\">");
  htmlContent += F("<div class=\"form-group\">");
  if(metricUnitsEnabled()){
    htmlContent += F("<input type=\"radio\" id=\"imperial\" name=\"units\" value=\"imperial\">");
  } else {
    htmlContent += F("<input type=\"radio\" id=\"imperial\" name=\"units\" value=\"imperial\" checked>");
  }
  htmlContent += F("<label for=\"imperial\">Imperial (Gallons, DegF, PSI)</label><br>");
  if(metricUnitsEnabled()){
    htmlContent += F("<input type=\"radio\" id=\"metric\" name=\"units\" value=\"metric\" checked>");
  } else {
    htmlContent += F("<input type=\"radio\" id=\"metric\" name=\"units\" value=\"metric\">");
  }
  htmlContent += F("<label for=\"metric\">Metric (Liters, DegC, kPa)</label><br>");
  htmlContent += F("<button type='button submit' class='btn btn-primary btn-lg'>UPDATE</button></form>");
  htmlContent += F("</div>");
  htmlContent += F("</h5>");

  char pressureOffset[5];
  char levelLowCal[5];
  char levelHighCal[5];
  char distanceLowCal[5];
  char distanceHighCal[5];

  htmlContent += F("<h4><p><b>Current Calibration Settings</b></p></h4>");
  htmlContent += F("<h5>");
  if(metricUnitsEnabled()){
    htmlContent += F("<p><b>High Level Cal: </b>");
    dtostrf(gallonsToLiters(fliteSensorBlack.getCalibrationLevelHigh()), 1, 1, levelHighCal);
    htmlContent += FPSTR(levelHighCal);
    htmlContent += F(" Liters</p>");
    htmlContent += F("<p><b>Low Level Cal: </b>");
    dtostrf(gallonsToLiters(fliteSensorBlack.getCalibrationLevelLow()), 1, 1, levelLowCal);
    htmlContent += FPSTR(levelLowCal);
    htmlContent += F(" Liters</p>");
    htmlContent += F("<p><b>High Distance Cal: </b>");
    dtostrf(fliteSensorBlack.getCalibrationDistanceHigh(), 0, 0, distanceHighCal);
    htmlContent += FPSTR(distanceHighCal);
    htmlContent += F(" mm</p>");
    htmlContent += F("<p><b>Low Distance Cal: </b>");
    dtostrf(fliteSensorBlack.getCalibrationDistanceLow(), 0, 0, distanceLowCal);
    htmlContent += FPSTR(distanceLowCal);
    htmlContent += F(" mm</p>");
    htmlContent += F("<p><b>Pressure Offset: </b>");
    dtostrf(psiTokPa(fliteSensorBlack.getCalibrationZeroPSI()), 1, 1, pressureOffset);
    htmlContent += FPSTR(pressureOffset);
    htmlContent += F(" kPa</p>");
  } else {
    htmlContent += F("<p><b>High Level Cal: </b>");
    dtostrf(fliteSensorBlack.getCalibrationLevelHigh(), 1, 1, levelHighCal);
    htmlContent += FPSTR(levelHighCal);
    htmlContent += F(" Gallons</p>");
    htmlContent += F("<p><b>Low Level Cal: </b>");
    dtostrf(fliteSensorBlack.getCalibrationLevelLow(), 1, 1, levelLowCal);
    htmlContent += FPSTR(levelLowCal);
    htmlContent += F(" Gallons</p>");
    htmlContent += F("<p><b>High Distance Cal: </b>");
    dtostrf(fliteSensorBlack.getCalibrationDistanceHigh(), 0, 0, distanceHighCal);
    htmlContent += FPSTR(distanceHighCal);
    htmlContent += F(" mm</p>");
    htmlContent += F("<p><b>Low Distance Cal: </b>");
    dtostrf(fliteSensorBlack.getCalibrationDistanceLow(), 0, 0, distanceLowCal);
    htmlContent += FPSTR(distanceLowCal);
    htmlContent += F(" mm</p>");
    htmlContent += F("<p><b>Pressure Offset: </b>");
    dtostrf(fliteSensorBlack.getCalibrationZeroPSI(), 1, 1, pressureOffset);
    htmlContent += FPSTR(pressureOffset);
    htmlContent += F(" PSI</p>");
  }
  htmlContent += F("</div>");
  htmlContent += F("</h5>");

  htmlContent += F("<div class=\"col\">");
  htmlContent += F("<form action=\"/highCalibration\" method=\"POST\">");
  htmlContent += F("<div class=\"form-group\">");
  if(metricUnitsEnabled()){
    htmlContent += F("<label for=\"calibrationLevelHigh\">High Calibration Level (Liters)</label>");
    htmlContent += F("<input type=\"number\" class=\"form-control\" name=\"calibrationLevelHigh\" min=\"0\" max=\"19\" step=\"0.1\" value=\"");
  } else {
    htmlContent += F("<label for=\"calibrationLevelHigh\">High Calibration Level (Gallons)</label>");
    htmlContent += F("<input type=\"number\" class=\"form-control\" name=\"calibrationLevelHigh\" min=\"0\" max=\"5\" step=\"0.1\" value=\"");
  }
  htmlContent += FPSTR(levelHighCal);
  htmlContent += F("\">");
  htmlContent += F("<button type='button submit' class='btn btn-primary btn-lg'>CALIBRATE HIGH LEVEL</button></form>");
  htmlContent += F("</div>");
  
  htmlContent += F("<form action=\"/lowCalibration\" method=\"POST\">");
  htmlContent += F("<div class=\"form-group\">");
  if(metricUnitsEnabled()){
    htmlContent += F("<label for=\"calibrationLevelLow\">Low Calibration Level (Liters)</label>");
    htmlContent += F("<input type=\"number\" class=\"form-control\" name=\"calibrationLevelHigh\" min=\"0\" max=\"19\" step=\"0.1\" value=\"");
  } else {
    htmlContent += F("<label for=\"calibrationLevelLow\">Low Calibration Level (Gallons)</label>");
    htmlContent += F("<input type=\"number\" class=\"form-control\" name=\"calibrationLevelHigh\" min=\"0\" max=\"5\" step=\"0.1\" value=\"");
  }
  htmlContent += FPSTR(levelLowCal);
  htmlContent += F("\">");
  htmlContent += F("<button type='button submit' class='btn btn-primary btn-lg'>CALIBRATE LOW LEVEL</button></form>");
  htmlContent += F("</div>");
  

  htmlContent += F("<form action=\"/zeroPressure\" method='POST'><button type='button submit' class='btn btn-primary btn-lg'>CALIBRATE ZERO PRESSURE</button></form>");
  htmlContent += F("</div>");
  
  htmlContent += F("</div>");
  
  htmlContent += F("<div class=\"row\">");
  htmlContent += F("<div class=\"col\">");
  
  htmlContent += F("<h1 style=\"background-color:#60b0f4;\">");
  htmlContent += F("<p style=\"color:#5d5d5d;\">WIFI CONFIGURATION</p>");
  htmlContent += F("</h1>");

  htmlContent += F("<h5><p>IP Address: ");
  //htmlContent += FPSTR(ip2CharArray(WiFi.localIP()));
  if(WiFi.status() == WL_CONNECTED) {
      // Connected to WiFi - Print the stored SSID & current IP address
      htmlContent += FPSTR(WiFi.localIP().toString().c_str());
  } else {
      // NOT Connected to WiFi - Print the softAP IP address
      htmlContent += FPSTR(WiFi.softAPIP().toString().c_str());
  }
  htmlContent += F("</p></h5>");

  if(isCloudServiceEnabled()){
    char minUntil[5];
    int updateIntervalSec = CLOUD_UPDATE_INTERVAL * 60;
    int minutesUntilUpdate = CLOUD_UPDATE_INTERVAL - ((secondsCounter % updateIntervalSec)/60);
    dtostrf(minutesUntilUpdate, 0, 0, minUntil);
    htmlContent += F("<h5><p>Next cloud services update in ");
    htmlContent += FPSTR(minUntil);
    htmlContent += F(" minutes...</p></h5>");
  } else {
    htmlContent += F("<h5><p>Cloud services not configured</p></h5>");
  }

  htmlContent += F("<div class=\"row\"><div class=\"col\"><form action=\"/testWiFi\" method='POST'><button type='button submit' class='btn btn-primary btn-lg'>TEST CLOUD UPDATE</button></form></div></div>");

  htmlContent += F("<form action=\"/updateWiFi\" method=\"POST\">");
  htmlContent += F("<div class=\"form-group\">");
  htmlContent += F("<label for=\"ssid\">SSID</label>");
  htmlContent += F("<input type=\"text\" class=\"form-control\" name=\"ssid\" placeholder=\"SSID\" value=\"");
  htmlContent += FPSTR(getWiFiSSID());
  htmlContent += F("\"></br>");
  htmlContent += F("</div>");
  htmlContent += F("<div class=\"form-group\">");
  htmlContent += F("<label for=\"password\">Password</label>");
  htmlContent += F("<input type=\"password\" class=\"form-control\" name=\"password\" placeholder=\"Password\" value=\"");
  htmlContent += FPSTR(getWiFiPassword());
  htmlContent += F("\"></br>");
  htmlContent += F("</div>");
  htmlContent += F("<button type=\"submit\" class=\"btn btn-primary btn-lg\">UPDATE</button>");
  htmlContent += F("</form>");
  
  htmlContent += F("</div>");
  htmlContent += F("</div>");
  
  htmlContent += F("<div class=\"row\">");
  htmlContent += F("<div class=\"col\">");
  
  htmlContent += F("<h1 style=\"background-color:#60b0f4;\">");
  htmlContent += F("  <p style=\"color:#5d5d5d;\">FLITE API CONFIGURATION</p>");
  htmlContent += F("</h1>");

  htmlContent += F("<form action=\"/updateFliteAPIKeys\" method=\"POST\">");
  htmlContent += F("<div class=\"form-check\">");
  if(fliteEnabled()){
    htmlContent += F("<input type=\"checkbox\" class=\"form-check-input\" name=\"fliteAPIEnabled\" value=\"true\" checked>");
  } else {
    htmlContent += F("<input type=\"checkbox\" class=\"form-check-input\" name=\"fliteAPIEnabled\" value=\"true\">");
  }
  htmlContent += F("<label class=\"form-check-label\" for=\"fliteAPIEnabled\">Enable</label>");
  htmlContent += F("</div>");
  htmlContent += F("<div class=\"form-group\">");
  htmlContent += F("<label for=\"id\">Application ID</label>");
  htmlContent += F("<input type=\"text\" class=\"form-control\" name=\"id\" placeholder=\"Application ID\" value=\"");
  htmlContent += FPSTR(getFliteAppID());
  htmlContent += F("\"></br>");
  htmlContent += F("</div>");
  htmlContent += F("<div class=\"form-group\">");
  htmlContent += F("<label for=\"key\">API Key</label>");
  htmlContent += F("<input type=\"text\" class=\"form-control\" name=\"key\" placeholder=\"API Key\" value=\"");
  htmlContent += FPSTR(getFliteAPIKey());
  htmlContent += F("\"></br>");
  htmlContent += F("</div>");
  htmlContent += F("<button type=\"submit\" class=\"btn btn-primary btn-lg\">UPDATE</button>");
  htmlContent += F("</form>");
  
  htmlContent += F("</div>");
  htmlContent += F("</div>");

  htmlContent += F("<div class=\"row\">");
  htmlContent += F("<div class=\"col\">");
  
  htmlContent += F("<h1 style=\"background-color:#60b0f4;\">");
  htmlContent += F("  <p style=\"color:#5d5d5d;\">TAPLIST.IO API CONFIGURATION</p>");
  htmlContent += F("</h1>");

  htmlContent += F("<form action=\"/updateTaplistAPI\" method=\"POST\">");
  htmlContent += F("<div class=\"form-check\">");
  if(taplistEnabled()){
    htmlContent += F("<input type=\"checkbox\" class=\"form-check-input\" name=\"taplistAPIEnabled\" value=\"true\" checked>");
  } else {
    htmlContent += F("<input type=\"checkbox\" class=\"form-check-input\" name=\"taplistAPIEnabled\" value=\"true\">");
  }
  htmlContent += F("<label class=\"form-check-label\" for=\"taplistAPIEnabled\">Enable</label>");
  htmlContent += F("</div>");
  htmlContent += F("<div class=\"form-group\">");
  htmlContent += F("<label for=\"id\">API Key</label>");
  htmlContent += F("<input type=\"text\" class=\"form-control\" name=\"APIkey\" placeholder=\"API Key\" value=\"");
  htmlContent += FPSTR(getTaplistAPIKey());
  htmlContent += F("\"></br>");
  htmlContent += F("</div>");
  htmlContent += F("<div class=\"form-group\">");
  htmlContent += F("<label for=\"key\">Venue ID</label>");
  htmlContent += F("<input type=\"text\" class=\"form-control\" name=\"venueid\" placeholder=\"Venue ID\" value=\"");
  htmlContent += FPSTR(getTaplistVenueID());
  htmlContent += F("\"></br>");
  htmlContent += F("</div>");
  htmlContent += F("<div class=\"form-group\">");
  htmlContent += F("<label for=\"key\">Tap ID</label>");
  htmlContent += F("<input type=\"text\" class=\"form-control\" name=\"tapid\" placeholder=\"Tap ID\" value=\"");
  htmlContent += FPSTR(getTaplistTapID());
  htmlContent += F("\"></br>");
  htmlContent += F("</div>");
  htmlContent += F("<button type=\"submit\" class=\"btn btn-primary btn-lg\">UPDATE</button>");
  htmlContent += F("</form>");
  
  htmlContent += F("</div>");
  htmlContent += F("</div>");

  htmlContent += F("</div>");
  htmlContent += F("</body>");
  htmlContent += F("</html>");
  
  //Provide content
  server.send(200, "text/HTML", htmlContent);
}

//Send HTTP status 404 (Not Found) when there's no handler for the URI in the request
void handleNotFound(){
  server.send(404, "text/plain", "404: Not found");
}

//If a post is made to update the user's ssid and password
void handleUpdateWiFiSettings() {
  //Make sure the POST has values for ssid and password
  if( ! server.hasArg("ssid") || server.arg("ssid") == NULL || ! server.hasArg("password") || server.arg("password") == NULL) {
    // The request is invalid, so send HTTP status 400
    server.send(400, "text/plain", "400: Invalid Request");
    return;
  } else {
    char clientSSID[30] = "";
    char clientPassword[30] = "";
    //Update the wifi settings
    //Get the strings from the HTML field arguments
    String ssidHTML = server.arg("ssid");
    String passwordHTML = server.arg("password");
    strncpy(clientSSID, ssidHTML.c_str(), 30);
    strncpy(clientPassword, passwordHTML.c_str(), 30);  
    //Store SSID in EEPROM
    EEPROM.put(1, clientSSID);
    //Store password in EEPROM
    EEPROM.put(31, clientPassword);
    EEPROM.commit();
    //Update the browser
    String htmlContent = "";
    htmlContent += "<h1>Successfully updated WiFi settings!</h1><h1>SSID: " + server.arg("ssid") + "</h1><h1>Password: " + server.arg("password") + "</h1>";
    server.send(200, "text/html", htmlContent);
    //Disconnect from the previous AP
    disconnectFromWiFi();
    //Connect to the new WiFi AP
    connectToWiFi();
  }
}

//If the user would like to force an update to parse server
void handleTestWiFiSettings() {
  //Update cloud services
  saveToCloud();
  //Update the browser
  String htmlContent = "";
  htmlContent += "<h1>Sent update to cloud services!</h1>";
  server.send(200, "text/html", htmlContent);
}

//A user has changed the units
void handleUpdateUnits(){
  if( ! server.hasArg("units") || server.arg("units") == NULL) {
    // The request is invalid, so send HTTP status 400
    server.send(400, "text/plain", "400: Invalid Request");
    return;
  } else {
    //Assign HTML field to the level holder
    if(server.arg("units") == "metric"){
      EEPROM.put(171, "true");
    } else {
      EEPROM.put(171, "false");
    }
    EEPROM.commit();
    //Update the browser
    String htmlContent = "";
    htmlContent += "<h1>Successfully updated units!</h1>";
    server.send(200, "text/html", htmlContent);
    showFooter("Units updated...");
    //Update displayed calibration settings
    updateDisplayedConfig();
  }
}

//A user has zeroed the pressure calibration
void handleZeroPressure() {
  onCalibrateZeroPSITouch();
}

//A user has selected high calibration calibration
void handleHighCalibration() {
  //Make sure the POST has values calibration high level
  if( ! server.hasArg("calibrationLevelHigh") || server.arg("calibrationLevelHigh") == NULL) {
    // The request is invalid, so send HTTP status 400
    server.send(400, "text/plain", "400: Invalid Request");
    return;
  } else {
    //Assign HTML field to the level holder
    String calibrationLevel = server.arg("calibrationLevelHigh");
    levelHolder = calibrationLevel.toFloat();
    //Calibrate high
    onCalibrateHighTouch();
  }
}

//A user has selected low calibration calibration
void handleLowCalibration() {
  //Make sure the POST has values calibration high level
  if( ! server.hasArg("calibrationLevelLow") || server.arg("calibrationLevelLow") == NULL) {
    // The request is invalid, so send HTTP status 400
    server.send(400, "text/plain", "400: Invalid Request");
    return;
  } else {
    //Assign HTML field to the level holder
    String calibrationLevel = server.arg("calibrationLevelLow");
    levelHolder = calibrationLevel.toFloat();
    //Calibrate low
    onCalibrateLowTouch();
  }
}

//If a post is made to update the Flite API Keys
void handleUpdateFliteAPIKeys() {
  //Make sure the POST has values for id and key
  if( ! server.hasArg("id") || server.arg("id") == NULL || ! server.hasArg("key") || server.arg("key") == NULL) {
    // The request is invalid, so send HTTP status 400
    server.send(400, "text/plain", "400: Invalid Request");
    return;
  } else {
    //Variables for Flite API
    char fliteAppID[50] = "";
    char fliteAPIKey[50] = "";
    //Update the API keys
    //Get the strings from the HTML field arguments
    String idHTML = server.arg("id");
    String keyHTML = server.arg("key");
    //strncpy(fliteEnabled, enabledHTML.c_str(), 10);
    strncpy(fliteAppID, idHTML.c_str(), 50);
    strncpy(fliteAPIKey, keyHTML.c_str(), 50);  
    //Store enabled in EEPROM
    if(server.arg("fliteAPIEnabled") == "true"){
      EEPROM.put(151, "true");
    } else {
      EEPROM.put(151, "false");
    }
    //Store ID in EEPROM
    EEPROM.put(401, fliteAppID);
    //Store key in EEPROM
    EEPROM.put(451, fliteAPIKey);
    EEPROM.commit();
    //Update the browser
    String htmlContent = "";
    htmlContent += "<h1>Successfully saved Flite API configuration!</h1><h1>Application ID: " + server.arg("id") + "</h1><h1>API Key: " + server.arg("key") + "</h1>";
    server.send(200, "text/html", htmlContent);
    showFooter("Flite API keys updated...");
  }
}

//If a post is made to update the Taplist API Keys
void handleUpdateTaplistAPIKeys() {
  //Make sure the POST has values for id and key
  if( ! server.hasArg("APIkey") || server.arg("APIkey") == NULL || ! server.hasArg("venueid") || server.arg("venueid") == NULL || ! server.hasArg("tapid") || server.arg("tapid") == NULL) {
    // The request is invalid, so send HTTP status 400
    server.send(400, "text/plain", "400: Invalid Request");
    return;
  } else {
    //Variables for Taplist.io API
    char taplistAPIKey[60] = "";
    char taplistVenueID[20] = "";
    char taplistTapID[5] = "";
    //Update the API keys
    //Get the strings from the HTML field arguments
    String keyHTML = server.arg("APIkey");
    String venueidHTML = server.arg("venueid");
    String tapidHTML = server.arg("tapid");
    //strncpy(taplistEnabled, enabledHTML.c_str(), 10);
    strncpy(taplistAPIKey, keyHTML.c_str(), 60);
    strncpy(taplistVenueID, venueidHTML.c_str(), 20);  
    strncpy(taplistTapID, tapidHTML.c_str(), 5);
    if(server.arg("taplistAPIEnabled") == "true"){
      EEPROM.put(161, "true");
    } else {
      EEPROM.put(161, "false");
    }
    EEPROM.put(61, taplistAPIKey);
    EEPROM.put(121, taplistVenueID);
    EEPROM.put(141, taplistTapID);
    EEPROM.commit();
    //Update the browser
    String htmlContent = "";
    htmlContent += "<h1>Successfully saved Taplist.io API configuration!</h1><h1>API Key: " + server.arg("APIkey") + "</h1><h1>Venue ID: " + server.arg("venueid") + "</h1><h1>Tap ID: " + server.arg("tapid") + "</h1>";
    server.send(200, "text/html", htmlContent);
    showFooter("Taplist.io API keys updated...");
  }
}

//Assign keg sensor selections to EEPROM
void setfliteSensorSelection(String selections){
  strncpy(sensorSelections, selections.c_str(), 10);
  EEPROM.put(181, sensorSelections);
  EEPROM.commit();
  delay(1000);
}

char * getFliteAPIEnabled(){
  static char fliteEnabled[10];
  EEPROM.get(151, fliteEnabled);
  return fliteEnabled;
}

bool fliteEnabled(){
  bool enabled = false;
  if(strcmp(getFliteAPIEnabled(), "true") == 0){
    enabled = true;
  }
  return enabled;
}

char * getFliteAppID(){
  static char fliteAppID[50];
  EEPROM.get(401, fliteAppID);
  return fliteAppID;
}

char * getFliteAPIKey(){
  static char fliteAPIKey[50];
  EEPROM.get(451, fliteAPIKey);
  return fliteAPIKey;
}

char * getTaplistAPIEnabled(){
  static char taplistEnabled[10];
  EEPROM.get(161, taplistEnabled);
  return taplistEnabled;
}

bool taplistEnabled(){
  bool enabled = false;
  if(strcmp(getTaplistAPIEnabled(), "true") == 0){
    enabled = true;
  }
  return enabled;
}

char * getTaplistAPIKey(){
  static char taplistAPIKey[60];
  EEPROM.get(61, taplistAPIKey);
  return taplistAPIKey;
}

char * getTaplistVenueID(){
  static char taplistVenueID[20];
  EEPROM.get(121, taplistVenueID);
  return taplistVenueID;
}

char * getTaplistTapID(){
  static char taplistTapID[5];
  EEPROM.get(141, taplistTapID);
  return taplistTapID;
}

char * getWiFiSSID(){
  static char clientSSID[30];
  EEPROM.get(1, clientSSID);
  return clientSSID;
}

char * getWiFiPassword(){
  static char clientPassword[30];
  EEPROM.get(31, clientPassword);
  return clientPassword;
}

char * getMetricUnitsEnabled(){
  static char metricUnitsEnabled[10];
  EEPROM.get(171, metricUnitsEnabled);
  return metricUnitsEnabled;
}

bool metricUnitsEnabled(){
  bool enabled = false;
  if(strcmp(getMetricUnitsEnabled(), "true") == 0){
    enabled = true;
  }
  return enabled;
}

//Determine which fliteSensors are selected bason on EEPROM
//[black, blue, red, green]
void getfliteSensorSelection(){
  EEPROM.get(181, sensorSelections);
}